## board/variscite/am62x_var_som/Kconfig
```kconfig
# SPDX-License-Identifier: GPL-2.0+
#
# Copyright (C) 2020-2022 Texas Instruments Incorporated - https://www.ti.com/
#	Suman Anna <s-anna@ti.com>
# Copyright (C) 2023-2025 Variscite Ltd. - https://www.variscite.com/


if TARGET_AM62X_VAR_SOM_A53

config SYS_BOARD
       default "am62x_var_som"

config SYS_VENDOR
       default "variscite"

config SYS_CONFIG_NAME
       default "am62x_var_som"

source "board/ti/common/Kconfig"

endif

if TARGET_AM62X_VAR_SOM_R5

config SYS_BOARD
       default "am62x_var_som"

config SYS_VENDOR
       default "variscite"

config SYS_CONFIG_NAME
       default "am62x_var_som"

config SPL_LDSCRIPT
	default "arch/arm/mach-omap2/u-boot-spl.lds"

source "board/ti/common/Kconfig"

endif
```
