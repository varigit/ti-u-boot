// SPDX-License-Identifier: GPL-2.0+
/*
 * Copyright (C) 2023 Variscite Ltd - http://www.variscite.com/
 */

/ {
	panel {
		u-boot,dm-pre-reloc;
	};
};


&mmc2 {
	status = "disabled";
};

&mmc3 {
	status = "disabled";
};
