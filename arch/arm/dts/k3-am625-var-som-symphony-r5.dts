// SPDX-License-Identifier: GPL-2.0
/*
 * VAR-SOM-AM62 dts file for R5 SPL
 * Copyright (C) 2021-2022 Texas Instruments Incorporated - https://www.ti.com/
 * Copyright (C) 2023-2025 Variscite Ltd. - https://www.variscite.com/
 */

#include "k3-am625-var-som-symphony.dts"
#include "k3-am625-var-som-ddr4-1600MTs.dtsi"
#include "k3-am62-ddr.dtsi"

#include "k3-am625-var-som-symphony-u-boot.dtsi"
#include "k3-am625-var-som-r5.dtsi"

/* Main UART1 is used for TIFS firmware logs */
&main_uart1 {
	status = "okay";
};

/* WKUP UART0 is used for DM firmware logs */
&wkup_uart0 {
	status = "okay";
};
