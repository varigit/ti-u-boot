// SPDX-License-Identifier: GPL-2.0
/*
 * VAR-SOM-AM62P SYMPHONY dts file for R5 SPL - Secure Boot
 * Copyright (C) 2023 Texas Instruments Incorporated - https://www.ti.com/
 * Copyright (C) 2025 Variscite Ltd. - https://www.variscite.com/
 */

#include "k3-am62p5-r5-var-som-common.dtsi"
#ifdef CONFIG_TARGET_AM62P5_R5_VAR_SOM
#include "var-som-hs-se-binman.dtsi"
#endif

&hs_se_bin {
	filename = "tiboot3-am62px-hs-am62px-var-som-secureboot.bin";
};

&hs_fs_bin {
	filename = "tiboot3-am62px-hs-fs-am62px-var-som-secureboot.bin";
};

#include "k3-am62p5-r5-var-som-symphony-common.dtsi"
