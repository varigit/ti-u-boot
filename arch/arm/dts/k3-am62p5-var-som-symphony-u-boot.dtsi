// SPDX-License-Identifier: GPL-2.0
/*
 * Common VAR-SOM-AM62Px dts file for SPLs
 * Copyright (C) 2022 Texas Instruments Incorporated - https://www.ti.com/
 * Copyright (C) 2025-2026 Variscite Ltd. - https://www.variscite.com/
 */

#include "k3-am62p-var-som-symphony-binman.dtsi"

/ {
	chosen {
		stdout-path = "serial2:115200n8";
		tick-timer = &main_timer0;
	};

	reserved-memory {
		bootph-pre-ram;
	};
};

&dss0 {
	compatible = "ti,am625-dss";
	clocks = <&k3_clks 186 6>,
		 <&k3_clks 186 0>,
		 <&k3_clks 186 2>;
	ti,am65x-oldi-io-ctrl = <&dss_oldi_io_ctrl>;
};

&wkup_r5fss0_core0_memory_region {
	bootph-pre-ram;
};

&cbass_wakeup {
	bootph-pre-ram;
};

&dmsc {
	bootph-pre-ram;
};

/* Required for USB DFU Boot */
&usb0_phy_ctrl {
	bootph-all;
};

&usb0 {
	bootph-all;
};

&ddr_pmctrl {
	bootph-pre-ram;
};

&canuart_wake {
	bootph-pre-ram;
};

&wkup_r5fss0 {
	bootph-pre-ram;
};

&wkup_r5fss0_core0 {
	bootph-pre-ram;
};

&cpsw_mac_syscon {
	bootph-all;
};

&cpsw_port1 {
	/* Variscite MAC addresses assigned by EEPROM/env */
	/delete-property/ ti,syscon-efuse;
	bootph-all;
};

&main_pktdma {
	bootph-all;
};

&main_rgmii1_pins_default {
	bootph-all;
};

&main_mdio1_pins_default {
	bootph-all;
};

&cpsw3g_phy0 {
	bootph-all;
};

&cpsw3g_mdio {
	bootph-all;
};

&phy_gmii_sel {
	bootph-all;
};

&cpsw_port2 {
	bootph-all;
};

&main_i2c0 {
	bootph-all;
};

&main_i2c0_pins_default {
	bootph-all;
};

&main_i2c1 {
	bootph-all;
};

&main_i2c1_pins_default {
	bootph-all;
};

/* Keep all I2C interfaces enabled through all boot phases.
   This way we can ensure that I2C3 with EEPROM access will always be I2C3
*/
&main_i2c2 {
	bootph-all;
};


&main_i2c3 {
	/delete-property/ power-domains;
	bootph-all;
};

&main_i2c3_pins_default {
	bootph-all;
};

&main_gpio0 {
	bootph-all;
};

&main_rgmii1_pins_default {
	bootph-all;
};

&main_mdio1_pins_default {
	bootph-all;
};


	bootph-all;
};
